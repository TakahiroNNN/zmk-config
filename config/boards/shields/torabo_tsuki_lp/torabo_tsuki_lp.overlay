#include <dt-bindings/zmk/matrix_transform.h>
#include "torabo_tsuki_lp_layouts.dtsi"

/ {
    chosen {
        zmk,kscan = &kscan0;
        zmk,physical-layout = &physical_layout_s;
    };

    kscan0: kscan {
        compatible = "zmk,kscan-gpio-matrix";
        wakeup-source;
        diode-direction = "col2row";
        // ピン指定が空だとエラーになるため、仮の値を入れます
        row-gpios = <&pro_micro 0 GPIO_ACTIVE_HIGH>;
        col-gpios = <&pro_micro 1 GPIO_ACTIVE_HIGH>;
    };
};
